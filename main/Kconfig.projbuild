## main/Kconfig.projbuild
```kconfig
menu "Handheld Configuration"

config HANDHELD_DEVICE_NAME
    string "Device name"
    default "ESP C6 Handheld"

config HANDHELD_BOOT_SCREEN_MS
    int "Boot screen duration, ms"
    range 500 5000
    default 1800

config HANDHELD_JOYSTICK_DEADZONE_RAW
    int "Joystick deadzone, raw ADC units"
    range 100 1800
    default 950

config HANDHELD_JOYSTICK_SWAP_XY
    bool "Swap joystick X/Y axes"
    default y

config HANDHELD_JOYSTICK_INVERT_X
    bool "Invert joystick X axis after swap"
    default y

config HANDHELD_JOYSTICK_INVERT_Y
    bool "Invert joystick Y axis after swap"
    default n

config HANDHELD_WAKE_CLICK_COUNT
    int "Deep sleep wake click count"
    range 2 5
    default 3

config HANDHELD_WAKE_CLICK_WINDOW_MS
    int "Deep sleep wake click window, ms"
    range 700 4000
    default 2500

config HANDHELD_SD_MOUNT_ON_BOOT
    bool "Mount SD card on boot"
    default n

endmenu
```
